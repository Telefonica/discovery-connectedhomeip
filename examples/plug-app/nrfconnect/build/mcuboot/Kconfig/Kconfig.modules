## examples/plug-app/nrfconnect/build/mcuboot/Kconfig/Kconfig.modules
```kconfig
menu "nrf (/home/rusky4/ncs/v2.0.0/nrf)"
osource "/home/rusky4/ncs/v2.0.0/nrf/Kconfig.nrf"
config ZEPHYR_NRF_MODULE
	bool
	default y
endmenu
menu "mcuboot (/home/rusky4/ncs/v2.0.0/bootloader/mcuboot)"
osource "$(ZEPHYR_MCUBOOT_KCONFIG)"
config ZEPHYR_MCUBOOT_MODULE
	bool
	default y
endmenu
menu "mbedtls (/home/rusky4/ncs/v2.0.0/modules/crypto/mbedtls)"
osource "$(ZEPHYR_MBEDTLS_KCONFIG)"
config ZEPHYR_MBEDTLS_MODULE
	bool
	default y
endmenu
menu "trusted-firmware-m (/home/rusky4/ncs/v2.0.0/modules/tee/tf-m/trusted-firmware-m)"
osource "$(ZEPHYR_TRUSTED_FIRMWARE_M_KCONFIG)"
config ZEPHYR_TRUSTED_FIRMWARE_M_MODULE
	bool
	default y
endmenu
menu "cjson (/home/rusky4/ncs/v2.0.0/modules/lib/cjson)"
osource "$(ZEPHYR_CJSON_KCONFIG)"
config ZEPHYR_CJSON_MODULE
	bool
	default y
endmenu
menu "zcbor (/home/rusky4/ncs/v2.0.0/modules/lib/zcbor)"
osource "$(ZEPHYR_ZCBOR_KCONFIG)"
config ZEPHYR_ZCBOR_MODULE
	bool
	default y
endmenu
menu "memfault-firmware-sdk (/home/rusky4/ncs/v2.0.0/modules/lib/memfault-firmware-sdk)"
osource "/home/rusky4/ncs/v2.0.0/modules/lib/memfault-firmware-sdk/ports/zephyr/Kconfig"
config ZEPHYR_MEMFAULT_FIRMWARE_SDK_MODULE
	bool
	default y
endmenu
menu "canopennode (/home/rusky4/ncs/v2.0.0/modules/lib/canopennode)"
osource "$(ZEPHYR_CANOPENNODE_KCONFIG)"
config ZEPHYR_CANOPENNODE_MODULE
	bool
	default y
endmenu
menu "chre (/home/rusky4/ncs/v2.0.0/modules/lib/chre)"
osource "/home/rusky4/ncs/v2.0.0/modules/lib/chre/platform/zephyr/Kconfig"
config ZEPHYR_CHRE_MODULE
	bool
	default y
endmenu
menu "hal_nordic (/home/rusky4/ncs/v2.0.0/modules/hal/nordic)"
osource "$(ZEPHYR_HAL_NORDIC_KCONFIG)"
config ZEPHYR_HAL_NORDIC_MODULE
	bool
	default y
endmenu
menu "liblc3codec (/home/rusky4/ncs/v2.0.0/modules/lib/liblc3codec)"
osource "$(ZEPHYR_LIBLC3CODEC_KCONFIG)"
config ZEPHYR_LIBLC3CODEC_MODULE
	bool
	default y
endmenu
menu "littlefs (/home/rusky4/ncs/v2.0.0/modules/fs/littlefs)"
osource "$(ZEPHYR_LITTLEFS_KCONFIG)"
config ZEPHYR_LITTLEFS_MODULE
	bool
	default y
endmenu
menu "loramac-node (/home/rusky4/ncs/v2.0.0/modules/lib/loramac-node)"
osource "$(ZEPHYR_LORAMAC_NODE_KCONFIG)"
config ZEPHYR_LORAMAC_NODE_MODULE
	bool
	default y
endmenu
menu "lvgl (/home/rusky4/ncs/v2.0.0/modules/lib/gui/lvgl)"
osource "/home/rusky4/ncs/v2.0.0/modules/lib/gui/lvgl/zephyr/Kconfig"
config ZEPHYR_LVGL_MODULE
	bool
	default y
endmenu
menu "lz4 (/home/rusky4/ncs/v2.0.0/modules/lib/lz4)"
osource "$(ZEPHYR_LZ4_KCONFIG)"
config ZEPHYR_LZ4_MODULE
	bool
	default y
endmenu
menu "nanopb (/home/rusky4/ncs/v2.0.0/modules/lib/nanopb)"
osource "$(ZEPHYR_NANOPB_KCONFIG)"
config ZEPHYR_NANOPB_MODULE
	bool
	default y
endmenu
menu "TraceRecorder (/home/rusky4/ncs/v2.0.0/modules/debug/TraceRecorder)"
osource "/home/rusky4/ncs/v2.0.0/modules/debug/TraceRecorder/kernelports/Zephyr/Kconfig"
config ZEPHYR_TRACERECORDER_MODULE
	bool
	default y
endmenu
menu "zscilib (/home/rusky4/ncs/v2.0.0/modules/lib/zscilib)"
osource "/home/rusky4/ncs/v2.0.0/modules/lib/zscilib/Kconfig.zscilib"
config ZEPHYR_ZSCILIB_MODULE
	bool
	default y
endmenu
menu "nrfxlib (/home/rusky4/ncs/v2.0.0/nrfxlib)"
osource "/home/rusky4/ncs/v2.0.0/nrfxlib/Kconfig.nrfxlib"
config ZEPHYR_NRFXLIB_MODULE
	bool
	default y
endmenu
menu "connectedhomeip (/home/rusky4/Downloads/discovery-connectedhomeip/config/nrfconnect/chip-module)"
osource "/home/rusky4/Downloads/discovery-connectedhomeip/config/nrfconnect/chip-module/Kconfig"
config ZEPHYR_CONNECTEDHOMEIP_MODULE
	bool
	default y
endmenu
```
